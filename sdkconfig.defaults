## sdkconfig.defaults
```kconfig
# Core settings
CONFIG_FREERTOS_HZ=1000

# Flash & PSRAM Active
CONFIG_ESPTOOLPY_FLASHSIZE_16MB=y
CONFIG_ESPTOOLPY_FLASHSIZE="16MB"
CONFIG_SPIRAM=y
CONFIG_SPIRAM_MODE_OCT=y

# Arduino Core Stack
CONFIG_ARDUINO_LOOP_STACK_SIZE=8192

# 
CONFIG_BT_ENABLED=y
CONFIG_BT_CONTROLLER_ENABLED=y
CONFIG_BT_CONTROLLER_MODE_BLE_ONLY=y
CONFIG_BT_BLUEDROID_ENABLED=y
CONFIG_BT_BLE_ENABLED=y
CONFIG_BT_NIMBLE_ENABLED=n

CONFIG_BT_BLE_42_FEATURES_SUPPORTED=y

# ---ccache active ---
CONFIG_COMPILER_CXX_RE_ONLY=y
```
